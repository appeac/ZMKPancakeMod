## boards/shields/tabcake/Kconfig.defconfig
```kconfig
# Copyright (c) 2022 The ZMK Contributors
# SPDX-License-Identifier: MIT

if SHIELD_TABCAKE

config ZMK_KEYBOARD_NAME
    default "Tabcake"

endif
```
